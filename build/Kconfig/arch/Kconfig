## build/Kconfig/arch/Kconfig
```kconfig
# Load arch Kconfig descriptions.
osource "/work/zephyr/arch/x86/Kconfig"
osource "/work/zephyr/arch/xtensa/Kconfig"
osource "/work/zephyr/arch/sparc/Kconfig"
osource "/work/zephyr/arch/riscv/Kconfig"
osource "/work/zephyr/arch/posix/Kconfig"
osource "/work/zephyr/arch/nios2/Kconfig"
osource "/work/zephyr/arch/mips/Kconfig"
osource "/work/zephyr/arch/arm64/Kconfig"
osource "/work/zephyr/arch/arm/Kconfig"
osource "/work/zephyr/arch/arc/Kconfig"
```

## build/Kconfig/soc/Kconfig.soc
```kconfig
# Load SoC Kconfig descriptions.
osource "/zephyr/soc/xlnx/zynqmp/Kconfig.soc"
osource "/zephyr/soc/xlnx/zynq7000/Kconfig.soc"
osource "/zephyr/soc/xen/Kconfig.soc"
osource "/zephyr/soc/ti/simplelink/Kconfig.soc"
osource "/zephyr/soc/ti/lm3s6965/Kconfig.soc"
osource "/zephyr/soc/ti/k3/Kconfig.soc"
osource "/zephyr/soc/telink/tlsr/Kconfig.soc"
osource "/zephyr/soc/starfive/jh71xx/Kconfig.soc"
osource "/zephyr/soc/st/stm32/Kconfig.soc"
osource "/zephyr/soc/snps/qemu_arc/Kconfig.soc"
osource "/zephyr/soc/snps/nsim/arc_v/Kconfig.soc"
osource "/zephyr/soc/snps/nsim/arc_classic/Kconfig.soc"
osource "/zephyr/soc/snps/hsdk4xd/Kconfig.soc"
osource "/zephyr/soc/snps/hsdk/Kconfig.soc"
osource "/zephyr/soc/snps/emsk/Kconfig.soc"
osource "/zephyr/soc/snps/emsdp/Kconfig.soc"
osource "/zephyr/soc/snps/arc_iot/Kconfig.soc"
osource "/zephyr/soc/silabs/Kconfig.soc"
osource "/zephyr/soc/sifive/sifive_freedom/Kconfig.soc"
osource "/zephyr/soc/rockchip/Kconfig.soc"
osource "/zephyr/soc/renode/riscv_virtual/Kconfig.soc"
osource "/zephyr/soc/renesas/smartbond/Kconfig.soc"
osource "/zephyr/soc/renesas/rzt2m/Kconfig.soc"
osource "/zephyr/soc/renesas/rcar/Kconfig.soc"
osource "/zephyr/soc/renesas/ra/Kconfig.soc"
osource "/zephyr/soc/raspberrypi/Kconfig.soc"
osource "/zephyr/soc/quicklogic/eos_s3/Kconfig.soc"
osource "/zephyr/soc/qemu/virt_riscv/Kconfig.soc"
osource "/zephyr/soc/qemu/malta/Kconfig.soc"
osource "/zephyr/soc/openisa/rv32m1/Kconfig.soc"
osource "/zephyr/soc/nxp/s32/Kconfig.soc"
osource "/zephyr/soc/nxp/rw/Kconfig.soc"
osource "/zephyr/soc/nxp/mcx/Kconfig.soc"
osource "/zephyr/soc/nxp/lpc/Kconfig.soc"
osource "/zephyr/soc/nxp/layerscape/Kconfig.soc"
osource "/zephyr/soc/nxp/kinetis/Kconfig.soc"
osource "/zephyr/soc/nxp/imxrt/Kconfig.soc"
osource "/zephyr/soc/nxp/imx/Kconfig.soc"
osource "/zephyr/soc/nuvoton/numicro/Kconfig.soc"
osource "/zephyr/soc/nuvoton/numaker/Kconfig.soc"
osource "/zephyr/soc/nuvoton/npcx/Kconfig.soc"
osource "/zephyr/soc/nordic/Kconfig.soc"
osource "/zephyr/soc/neorv32/Kconfig.soc"
osource "/zephyr/soc/native/inf_clock/Kconfig.soc"
osource "/zephyr/soc/microchip/miv/Kconfig.soc"
osource "/zephyr/soc/microchip/mec/Kconfig.soc"
osource "/zephyr/soc/mediatek/mtk_adsp/Kconfig.soc"
osource "/zephyr/soc/lowrisc/opentitan/Kconfig.soc"
osource "/zephyr/soc/litex/litex_vexriscv/Kconfig.soc"
osource "/zephyr/soc/ite/ec/Kconfig.soc"
osource "/zephyr/soc/intel/raptor_lake/Kconfig.soc"
osource "/zephyr/soc/intel/lakemont/Kconfig.soc"
osource "/zephyr/soc/intel/intel_socfpga_std/Kconfig.soc"
osource "/zephyr/soc/intel/intel_socfpga/Kconfig.soc"
osource "/zephyr/soc/intel/intel_niosv/Kconfig.soc"
osource "/zephyr/soc/intel/intel_ish/Kconfig.soc"
osource "/zephyr/soc/intel/intel_adsp/Kconfig.soc"
osource "/zephyr/soc/intel/elkhart_lake/Kconfig.soc"
osource "/zephyr/soc/intel/atom/Kconfig.soc"
osource "/zephyr/soc/intel/apollo_lake/Kconfig.soc"
osource "/zephyr/soc/intel/alder_lake/Kconfig.soc"
osource "/zephyr/soc/infineon/cat3/Kconfig.soc"
osource "/zephyr/soc/infineon/cat1b/Kconfig.soc"
osource "/zephyr/soc/infineon/cat1a/Kconfig.soc"
osource "/zephyr/soc/gd/gd32/Kconfig.soc"
osource "/zephyr/soc/gaisler/leon3/Kconfig.soc"
osource "/zephyr/soc/gaisler/gr716a/Kconfig.soc"
osource "/zephyr/soc/espressif/Kconfig.soc"
osource "/zephyr/soc/ene/kb1200/Kconfig.soc"
osource "/zephyr/soc/efinix/sapphire/Kconfig.soc"
osource "/zephyr/soc/cdns/xtensa_sample_controller/Kconfig.soc"
osource "/zephyr/soc/cdns/dc233c/Kconfig.soc"
osource "/zephyr/soc/brcm/bcmvk/Kconfig.soc"
osource "/zephyr/soc/brcm/bcm2712/Kconfig.soc"
osource "/zephyr/soc/brcm/bcm2711/Kconfig.soc"
osource "/zephyr/soc/atmel/sam0/Kconfig.soc"
osource "/zephyr/soc/atmel/sam/Kconfig.soc"
osource "/zephyr/soc/aspeed/Kconfig.soc"
osource "/zephyr/soc/arm/Kconfig.soc"
osource "/zephyr/soc/arm/beetle/Kconfig.soc"
osource "/zephyr/soc/andestech/Kconfig.soc"
osource "/zephyr/soc/ambiq/Kconfig.soc"
osource "/zephyr/soc/altr/zephyr_nios2f/Kconfig.soc"
osource "/zephyr/soc/altr/qemu_nios2/Kconfig.soc"
osource "/zephyr/soc/adi/max32/Kconfig.soc"
```

## build/Kconfig/soc/Kconfig.sysbuild
```kconfig
# Load SoC sysbuild Kconfig descriptions.
osource "/work/zephyr/soc/xlnx/zynqmp/Kconfig.sysbuild"
osource "/work/zephyr/soc/xlnx/zynq7000/Kconfig.sysbuild"
osource "/work/zephyr/soc/xen/Kconfig.sysbuild"
osource "/work/zephyr/soc/ti/simplelink/Kconfig.sysbuild"
osource "/work/zephyr/soc/ti/lm3s6965/Kconfig.sysbuild"
osource "/work/zephyr/soc/ti/k3/Kconfig.sysbuild"
osource "/work/zephyr/soc/telink/tlsr/Kconfig.sysbuild"
osource "/work/zephyr/soc/starfive/jh71xx/Kconfig.sysbuild"
osource "/work/zephyr/soc/st/stm32/Kconfig.sysbuild"
osource "/work/zephyr/soc/snps/qemu_arc/Kconfig.sysbuild"
osource "/work/zephyr/soc/snps/nsim/arc_v/Kconfig.sysbuild"
osource "/work/zephyr/soc/snps/nsim/arc_classic/Kconfig.sysbuild"
osource "/work/zephyr/soc/snps/hsdk4xd/Kconfig.sysbuild"
osource "/work/zephyr/soc/snps/hsdk/Kconfig.sysbuild"
osource "/work/zephyr/soc/snps/emsk/Kconfig.sysbuild"
osource "/work/zephyr/soc/snps/emsdp/Kconfig.sysbuild"
osource "/work/zephyr/soc/snps/arc_iot/Kconfig.sysbuild"
osource "/work/zephyr/soc/silabs/Kconfig.sysbuild"
osource "/work/zephyr/soc/sifive/sifive_freedom/Kconfig.sysbuild"
osource "/work/zephyr/soc/rockchip/Kconfig.sysbuild"
osource "/work/zephyr/soc/renode/riscv_virtual/Kconfig.sysbuild"
osource "/work/zephyr/soc/renesas/smartbond/Kconfig.sysbuild"
osource "/work/zephyr/soc/renesas/rzt2m/Kconfig.sysbuild"
osource "/work/zephyr/soc/renesas/rcar/Kconfig.sysbuild"
osource "/work/zephyr/soc/renesas/ra/Kconfig.sysbuild"
osource "/work/zephyr/soc/raspberrypi/Kconfig.sysbuild"
osource "/work/zephyr/soc/quicklogic/eos_s3/Kconfig.sysbuild"
osource "/work/zephyr/soc/qemu/virt_riscv/Kconfig.sysbuild"
osource "/work/zephyr/soc/qemu/malta/Kconfig.sysbuild"
osource "/work/zephyr/soc/openisa/rv32m1/Kconfig.sysbuild"
osource "/work/zephyr/soc/nxp/s32/Kconfig.sysbuild"
osource "/work/zephyr/soc/nxp/rw/Kconfig.sysbuild"
osource "/work/zephyr/soc/nxp/mcx/Kconfig.sysbuild"
osource "/work/zephyr/soc/nxp/lpc/Kconfig.sysbuild"
osource "/work/zephyr/soc/nxp/layerscape/Kconfig.sysbuild"
osource "/work/zephyr/soc/nxp/kinetis/Kconfig.sysbuild"
osource "/work/zephyr/soc/nxp/imxrt/Kconfig.sysbuild"
osource "/work/zephyr/soc/nxp/imx/Kconfig.sysbuild"
osource "/work/zephyr/soc/nuvoton/numicro/Kconfig.sysbuild"
osource "/work/zephyr/soc/nuvoton/numaker/Kconfig.sysbuild"
osource "/work/zephyr/soc/nuvoton/npcx/Kconfig.sysbuild"
osource "/work/zephyr/soc/nordic/Kconfig.sysbuild"
osource "/work/zephyr/soc/neorv32/Kconfig.sysbuild"
osource "/work/zephyr/soc/native/inf_clock/Kconfig.sysbuild"
osource "/work/zephyr/soc/microchip/miv/Kconfig.sysbuild"
osource "/work/zephyr/soc/microchip/mec/Kconfig.sysbuild"
osource "/work/zephyr/soc/mediatek/mtk_adsp/Kconfig.sysbuild"
osource "/work/zephyr/soc/lowrisc/opentitan/Kconfig.sysbuild"
osource "/work/zephyr/soc/litex/litex_vexriscv/Kconfig.sysbuild"
osource "/work/zephyr/soc/ite/ec/Kconfig.sysbuild"
osource "/work/zephyr/soc/intel/raptor_lake/Kconfig.sysbuild"
osource "/work/zephyr/soc/intel/lakemont/Kconfig.sysbuild"
osource "/work/zephyr/soc/intel/intel_socfpga_std/Kconfig.sysbuild"
osource "/work/zephyr/soc/intel/intel_socfpga/Kconfig.sysbuild"
osource "/work/zephyr/soc/intel/intel_niosv/Kconfig.sysbuild"
osource "/work/zephyr/soc/intel/intel_ish/Kconfig.sysbuild"
osource "/work/zephyr/soc/intel/intel_adsp/Kconfig.sysbuild"
osource "/work/zephyr/soc/intel/elkhart_lake/Kconfig.sysbuild"
osource "/work/zephyr/soc/intel/atom/Kconfig.sysbuild"
osource "/work/zephyr/soc/intel/apollo_lake/Kconfig.sysbuild"
osource "/work/zephyr/soc/intel/alder_lake/Kconfig.sysbuild"
osource "/work/zephyr/soc/infineon/cat3/Kconfig.sysbuild"
osource "/work/zephyr/soc/infineon/cat1b/Kconfig.sysbuild"
osource "/work/zephyr/soc/infineon/cat1a/Kconfig.sysbuild"
osource "/work/zephyr/soc/gd/gd32/Kconfig.sysbuild"
osource "/work/zephyr/soc/gaisler/leon3/Kconfig.sysbuild"
osource "/work/zephyr/soc/gaisler/gr716a/Kconfig.sysbuild"
osource "/work/zephyr/soc/espressif/Kconfig.sysbuild"
osource "/work/zephyr/soc/ene/kb1200/Kconfig.sysbuild"
osource "/work/zephyr/soc/efinix/sapphire/Kconfig.sysbuild"
osource "/work/zephyr/soc/cdns/xtensa_sample_controller/Kconfig.sysbuild"
osource "/work/zephyr/soc/cdns/dc233c/Kconfig.sysbuild"
osource "/work/zephyr/soc/brcm/bcmvk/Kconfig.sysbuild"
osource "/work/zephyr/soc/brcm/bcm2712/Kconfig.sysbuild"
osource "/work/zephyr/soc/brcm/bcm2711/Kconfig.sysbuild"
osource "/work/zephyr/soc/atmel/sam0/Kconfig.sysbuild"
osource "/work/zephyr/soc/atmel/sam/Kconfig.sysbuild"
osource "/work/zephyr/soc/aspeed/Kconfig.sysbuild"
osource "/work/zephyr/soc/arm/Kconfig.sysbuild"
osource "/work/zephyr/soc/arm/beetle/Kconfig.sysbuild"
osource "/work/zephyr/soc/andestech/Kconfig.sysbuild"
osource "/work/zephyr/soc/ambiq/Kconfig.sysbuild"
osource "/work/zephyr/soc/altr/zephyr_nios2f/Kconfig.sysbuild"
osource "/work/zephyr/soc/altr/qemu_nios2/Kconfig.sysbuild"
osource "/work/zephyr/soc/adi/max32/Kconfig.sysbuild"
```

## build_native/Kconfig/arch/Kconfig
```kconfig
# Load arch Kconfig descriptions.
osource "/zephyr/arch/x86/Kconfig"
osource "/zephyr/arch/xtensa/Kconfig"
osource "/zephyr/arch/sparc/Kconfig"
osource "/zephyr/arch/riscv/Kconfig"
osource "/zephyr/arch/posix/Kconfig"
osource "/zephyr/arch/nios2/Kconfig"
osource "/zephyr/arch/mips/Kconfig"
osource "/zephyr/arch/arm64/Kconfig"
osource "/zephyr/arch/arm/Kconfig"
osource "/zephyr/arch/arc/Kconfig"
```

## build_native/Kconfig/soc/Kconfig
```kconfig
# Load Zephyr SoC Kconfig descriptions.
osource "/zephyr/soc/xlnx/zynqmp/Kconfig"
osource "/zephyr/soc/xlnx/zynq7000/Kconfig"
osource "/zephyr/soc/xen/Kconfig"
osource "/zephyr/soc/ti/simplelink/Kconfig"
osource "/zephyr/soc/ti/lm3s6965/Kconfig"
osource "/zephyr/soc/ti/k3/Kconfig"
osource "/zephyr/soc/telink/tlsr/Kconfig"
osource "/zephyr/soc/starfive/jh71xx/Kconfig"
osource "/zephyr/soc/st/stm32/Kconfig"
osource "/zephyr/soc/snps/qemu_arc/Kconfig"
osource "/zephyr/soc/snps/nsim/arc_v/Kconfig"
osource "/zephyr/soc/snps/nsim/arc_classic/Kconfig"
osource "/zephyr/soc/snps/hsdk4xd/Kconfig"
osource "/zephyr/soc/snps/hsdk/Kconfig"
osource "/zephyr/soc/snps/emsk/Kconfig"
osource "/zephyr/soc/snps/emsdp/Kconfig"
osource "/zephyr/soc/snps/arc_iot/Kconfig"
osource "/zephyr/soc/silabs/Kconfig"
osource "/zephyr/soc/sifive/sifive_freedom/Kconfig"
osource "/zephyr/soc/rockchip/Kconfig"
osource "/zephyr/soc/renode/riscv_virtual/Kconfig"
osource "/zephyr/soc/renesas/smartbond/Kconfig"
osource "/zephyr/soc/renesas/rzt2m/Kconfig"
osource "/zephyr/soc/renesas/rcar/Kconfig"
osource "/zephyr/soc/renesas/ra/Kconfig"
osource "/zephyr/soc/raspberrypi/Kconfig"
osource "/zephyr/soc/quicklogic/eos_s3/Kconfig"
osource "/zephyr/soc/qemu/virt_riscv/Kconfig"
osource "/zephyr/soc/qemu/malta/Kconfig"
osource "/zephyr/soc/openisa/rv32m1/Kconfig"
osource "/zephyr/soc/nxp/s32/Kconfig"
osource "/zephyr/soc/nxp/rw/Kconfig"
osource "/zephyr/soc/nxp/mcx/Kconfig"
osource "/zephyr/soc/nxp/lpc/Kconfig"
osource "/zephyr/soc/nxp/layerscape/Kconfig"
osource "/zephyr/soc/nxp/kinetis/Kconfig"
osource "/zephyr/soc/nxp/imxrt/Kconfig"
osource "/zephyr/soc/nxp/imx/Kconfig"
osource "/zephyr/soc/nuvoton/numicro/Kconfig"
osource "/zephyr/soc/nuvoton/numaker/Kconfig"
osource "/zephyr/soc/nuvoton/npcx/Kconfig"
osource "/zephyr/soc/nordic/Kconfig"
osource "/zephyr/soc/neorv32/Kconfig"
osource "/zephyr/soc/native/inf_clock/Kconfig"
osource "/zephyr/soc/microchip/miv/Kconfig"
osource "/zephyr/soc/microchip/mec/Kconfig"
osource "/zephyr/soc/mediatek/mtk_adsp/Kconfig"
osource "/zephyr/soc/lowrisc/opentitan/Kconfig"
osource "/zephyr/soc/litex/litex_vexriscv/Kconfig"
osource "/zephyr/soc/ite/ec/Kconfig"
osource "/zephyr/soc/intel/raptor_lake/Kconfig"
osource "/zephyr/soc/intel/lakemont/Kconfig"
osource "/zephyr/soc/intel/intel_socfpga_std/Kconfig"
osource "/zephyr/soc/intel/intel_socfpga/Kconfig"
osource "/zephyr/soc/intel/intel_niosv/Kconfig"
osource "/zephyr/soc/intel/intel_ish/Kconfig"
osource "/zephyr/soc/intel/intel_adsp/Kconfig"
osource "/zephyr/soc/intel/elkhart_lake/Kconfig"
osource "/zephyr/soc/intel/atom/Kconfig"
osource "/zephyr/soc/intel/apollo_lake/Kconfig"
osource "/zephyr/soc/intel/alder_lake/Kconfig"
osource "/zephyr/soc/infineon/cat3/Kconfig"
osource "/zephyr/soc/infineon/cat1b/Kconfig"
osource "/zephyr/soc/infineon/cat1a/Kconfig"
osource "/zephyr/soc/gd/gd32/Kconfig"
osource "/zephyr/soc/gaisler/leon3/Kconfig"
osource "/zephyr/soc/gaisler/gr716a/Kconfig"
osource "/zephyr/soc/espressif/Kconfig"
osource "/zephyr/soc/ene/kb1200/Kconfig"
osource "/zephyr/soc/efinix/sapphire/Kconfig"
osource "/zephyr/soc/cdns/xtensa_sample_controller/Kconfig"
osource "/zephyr/soc/cdns/dc233c/Kconfig"
osource "/zephyr/soc/brcm/bcmvk/Kconfig"
osource "/zephyr/soc/brcm/bcm2712/Kconfig"
osource "/zephyr/soc/brcm/bcm2711/Kconfig"
osource "/zephyr/soc/atmel/sam0/Kconfig"
osource "/zephyr/soc/atmel/sam/Kconfig"
osource "/zephyr/soc/aspeed/Kconfig"
osource "/zephyr/soc/arm/Kconfig"
osource "/zephyr/soc/arm/beetle/Kconfig"
osource "/zephyr/soc/andestech/Kconfig"
osource "/zephyr/soc/ambiq/Kconfig"
osource "/zephyr/soc/altr/zephyr_nios2f/Kconfig"
osource "/zephyr/soc/altr/qemu_nios2/Kconfig"
osource "/zephyr/soc/adi/max32/Kconfig"
```
