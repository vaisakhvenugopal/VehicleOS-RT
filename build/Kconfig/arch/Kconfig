## build_native/Kconfig/soc/Kconfig.defconfig
```kconfig
# Load Zephyr SoC Kconfig defconfig.
osource "/zephyr/soc/xlnx/zynqmp/Kconfig.defconfig"
osource "/zephyr/soc/xlnx/zynq7000/Kconfig.defconfig"
osource "/zephyr/soc/xen/Kconfig.defconfig"
osource "/zephyr/soc/ti/simplelink/Kconfig.defconfig"
osource "/zephyr/soc/ti/lm3s6965/Kconfig.defconfig"
osource "/zephyr/soc/ti/k3/Kconfig.defconfig"
osource "/zephyr/soc/telink/tlsr/Kconfig.defconfig"
osource "/zephyr/soc/starfive/jh71xx/Kconfig.defconfig"
osource "/zephyr/soc/st/stm32/Kconfig.defconfig"
osource "/zephyr/soc/snps/qemu_arc/Kconfig.defconfig"
osource "/zephyr/soc/snps/nsim/arc_v/Kconfig.defconfig"
osource "/zephyr/soc/snps/nsim/arc_classic/Kconfig.defconfig"
osource "/zephyr/soc/snps/hsdk4xd/Kconfig.defconfig"
osource "/zephyr/soc/snps/hsdk/Kconfig.defconfig"
osource "/zephyr/soc/snps/emsk/Kconfig.defconfig"
osource "/zephyr/soc/snps/emsdp/Kconfig.defconfig"
osource "/zephyr/soc/snps/arc_iot/Kconfig.defconfig"
osource "/zephyr/soc/silabs/Kconfig.defconfig"
osource "/zephyr/soc/sifive/sifive_freedom/Kconfig.defconfig"
osource "/zephyr/soc/rockchip/Kconfig.defconfig"
osource "/zephyr/soc/renode/riscv_virtual/Kconfig.defconfig"
osource "/zephyr/soc/renesas/smartbond/Kconfig.defconfig"
osource "/zephyr/soc/renesas/rzt2m/Kconfig.defconfig"
osource "/zephyr/soc/renesas/rcar/Kconfig.defconfig"
osource "/zephyr/soc/renesas/ra/Kconfig.defconfig"
osource "/zephyr/soc/raspberrypi/Kconfig.defconfig"
osource "/zephyr/soc/quicklogic/eos_s3/Kconfig.defconfig"
osource "/zephyr/soc/qemu/virt_riscv/Kconfig.defconfig"
osource "/zephyr/soc/qemu/malta/Kconfig.defconfig"
osource "/zephyr/soc/openisa/rv32m1/Kconfig.defconfig"
osource "/zephyr/soc/nxp/s32/Kconfig.defconfig"
osource "/zephyr/soc/nxp/rw/Kconfig.defconfig"
osource "/zephyr/soc/nxp/mcx/Kconfig.defconfig"
osource "/zephyr/soc/nxp/lpc/Kconfig.defconfig"
osource "/zephyr/soc/nxp/layerscape/Kconfig.defconfig"
osource "/zephyr/soc/nxp/kinetis/Kconfig.defconfig"
osource "/zephyr/soc/nxp/imxrt/Kconfig.defconfig"
osource "/zephyr/soc/nxp/imx/Kconfig.defconfig"
osource "/zephyr/soc/nuvoton/numicro/Kconfig.defconfig"
osource "/zephyr/soc/nuvoton/numaker/Kconfig.defconfig"
osource "/zephyr/soc/nuvoton/npcx/Kconfig.defconfig"
osource "/zephyr/soc/nordic/Kconfig.defconfig"
osource "/zephyr/soc/neorv32/Kconfig.defconfig"
osource "/zephyr/soc/native/inf_clock/Kconfig.defconfig"
osource "/zephyr/soc/microchip/miv/Kconfig.defconfig"
osource "/zephyr/soc/microchip/mec/Kconfig.defconfig"
osource "/zephyr/soc/mediatek/mtk_adsp/Kconfig.defconfig"
osource "/zephyr/soc/lowrisc/opentitan/Kconfig.defconfig"
osource "/zephyr/soc/litex/litex_vexriscv/Kconfig.defconfig"
osource "/zephyr/soc/ite/ec/Kconfig.defconfig"
osource "/zephyr/soc/intel/raptor_lake/Kconfig.defconfig"
osource "/zephyr/soc/intel/lakemont/Kconfig.defconfig"
osource "/zephyr/soc/intel/intel_socfpga_std/Kconfig.defconfig"
osource "/zephyr/soc/intel/intel_socfpga/Kconfig.defconfig"
osource "/zephyr/soc/intel/intel_niosv/Kconfig.defconfig"
osource "/zephyr/soc/intel/intel_ish/Kconfig.defconfig"
osource "/zephyr/soc/intel/intel_adsp/Kconfig.defconfig"
osource "/zephyr/soc/intel/elkhart_lake/Kconfig.defconfig"
osource "/zephyr/soc/intel/atom/Kconfig.defconfig"
osource "/zephyr/soc/intel/apollo_lake/Kconfig.defconfig"
osource "/zephyr/soc/intel/alder_lake/Kconfig.defconfig"
osource "/zephyr/soc/infineon/cat3/Kconfig.defconfig"
osource "/zephyr/soc/infineon/cat1b/Kconfig.defconfig"
osource "/zephyr/soc/infineon/cat1a/Kconfig.defconfig"
osource "/zephyr/soc/gd/gd32/Kconfig.defconfig"
osource "/zephyr/soc/gaisler/leon3/Kconfig.defconfig"
osource "/zephyr/soc/gaisler/gr716a/Kconfig.defconfig"
osource "/zephyr/soc/espressif/Kconfig.defconfig"
osource "/zephyr/soc/ene/kb1200/Kconfig.defconfig"
osource "/zephyr/soc/efinix/sapphire/Kconfig.defconfig"
osource "/zephyr/soc/cdns/xtensa_sample_controller/Kconfig.defconfig"
osource "/zephyr/soc/cdns/dc233c/Kconfig.defconfig"
osource "/zephyr/soc/brcm/bcmvk/Kconfig.defconfig"
osource "/zephyr/soc/brcm/bcm2712/Kconfig.defconfig"
osource "/zephyr/soc/brcm/bcm2711/Kconfig.defconfig"
osource "/zephyr/soc/atmel/sam0/Kconfig.defconfig"
osource "/zephyr/soc/atmel/sam/Kconfig.defconfig"
osource "/zephyr/soc/aspeed/Kconfig.defconfig"
osource "/zephyr/soc/arm/Kconfig.defconfig"
osource "/zephyr/soc/arm/beetle/Kconfig.defconfig"
osource "/zephyr/soc/andestech/Kconfig.defconfig"
osource "/zephyr/soc/ambiq/Kconfig.defconfig"
osource "/zephyr/soc/altr/zephyr_nios2f/Kconfig.defconfig"
osource "/zephyr/soc/altr/qemu_nios2/Kconfig.defconfig"
osource "/zephyr/soc/adi/max32/Kconfig.defconfig"
```

## build_native/Kconfig/soc/Kconfig.sysbuild
```kconfig
# Load SoC sysbuild Kconfig descriptions.
osource "/zephyr/soc/xlnx/zynqmp/Kconfig.sysbuild"
osource "/zephyr/soc/xlnx/zynq7000/Kconfig.sysbuild"
osource "/zephyr/soc/xen/Kconfig.sysbuild"
osource "/zephyr/soc/ti/simplelink/Kconfig.sysbuild"
osource "/zephyr/soc/ti/lm3s6965/Kconfig.sysbuild"
osource "/zephyr/soc/ti/k3/Kconfig.sysbuild"
osource "/zephyr/soc/telink/tlsr/Kconfig.sysbuild"
osource "/zephyr/soc/starfive/jh71xx/Kconfig.sysbuild"
osource "/zephyr/soc/st/stm32/Kconfig.sysbuild"
osource "/zephyr/soc/snps/qemu_arc/Kconfig.sysbuild"
osource "/zephyr/soc/snps/nsim/arc_v/Kconfig.sysbuild"
osource "/zephyr/soc/snps/nsim/arc_classic/Kconfig.sysbuild"
osource "/zephyr/soc/snps/hsdk4xd/Kconfig.sysbuild"
osource "/zephyr/soc/snps/hsdk/Kconfig.sysbuild"
osource "/zephyr/soc/snps/emsk/Kconfig.sysbuild"
osource "/zephyr/soc/snps/emsdp/Kconfig.sysbuild"
osource "/zephyr/soc/snps/arc_iot/Kconfig.sysbuild"
osource "/zephyr/soc/silabs/Kconfig.sysbuild"
osource "/zephyr/soc/sifive/sifive_freedom/Kconfig.sysbuild"
osource "/zephyr/soc/rockchip/Kconfig.sysbuild"
osource "/zephyr/soc/renode/riscv_virtual/Kconfig.sysbuild"
osource "/zephyr/soc/renesas/smartbond/Kconfig.sysbuild"
osource "/zephyr/soc/renesas/rzt2m/Kconfig.sysbuild"
osource "/zephyr/soc/renesas/rcar/Kconfig.sysbuild"
osource "/zephyr/soc/renesas/ra/Kconfig.sysbuild"
osource "/zephyr/soc/raspberrypi/Kconfig.sysbuild"
osource "/zephyr/soc/quicklogic/eos_s3/Kconfig.sysbuild"
osource "/zephyr/soc/qemu/virt_riscv/Kconfig.sysbuild"
osource "/zephyr/soc/qemu/malta/Kconfig.sysbuild"
osource "/zephyr/soc/openisa/rv32m1/Kconfig.sysbuild"
osource "/zephyr/soc/nxp/s32/Kconfig.sysbuild"
osource "/zephyr/soc/nxp/rw/Kconfig.sysbuild"
osource "/zephyr/soc/nxp/mcx/Kconfig.sysbuild"
osource "/zephyr/soc/nxp/lpc/Kconfig.sysbuild"
osource "/zephyr/soc/nxp/layerscape/Kconfig.sysbuild"
osource "/zephyr/soc/nxp/kinetis/Kconfig.sysbuild"
osource "/zephyr/soc/nxp/imxrt/Kconfig.sysbuild"
osource "/zephyr/soc/nxp/imx/Kconfig.sysbuild"
osource "/zephyr/soc/nuvoton/numicro/Kconfig.sysbuild"
osource "/zephyr/soc/nuvoton/numaker/Kconfig.sysbuild"
osource "/zephyr/soc/nuvoton/npcx/Kconfig.sysbuild"
osource "/zephyr/soc/nordic/Kconfig.sysbuild"
osource "/zephyr/soc/neorv32/Kconfig.sysbuild"
osource "/zephyr/soc/native/inf_clock/Kconfig.sysbuild"
osource "/zephyr/soc/microchip/miv/Kconfig.sysbuild"
osource "/zephyr/soc/microchip/mec/Kconfig.sysbuild"
osource "/zephyr/soc/mediatek/mtk_adsp/Kconfig.sysbuild"
osource "/zephyr/soc/lowrisc/opentitan/Kconfig.sysbuild"
osource "/zephyr/soc/litex/litex_vexriscv/Kconfig.sysbuild"
osource "/zephyr/soc/ite/ec/Kconfig.sysbuild"
osource "/zephyr/soc/intel/raptor_lake/Kconfig.sysbuild"
osource "/zephyr/soc/intel/lakemont/Kconfig.sysbuild"
osource "/zephyr/soc/intel/intel_socfpga_std/Kconfig.sysbuild"
osource "/zephyr/soc/intel/intel_socfpga/Kconfig.sysbuild"
osource "/zephyr/soc/intel/intel_niosv/Kconfig.sysbuild"
osource "/zephyr/soc/intel/intel_ish/Kconfig.sysbuild"
osource "/zephyr/soc/intel/intel_adsp/Kconfig.sysbuild"
osource "/zephyr/soc/intel/elkhart_lake/Kconfig.sysbuild"
osource "/zephyr/soc/intel/atom/Kconfig.sysbuild"
osource "/zephyr/soc/intel/apollo_lake/Kconfig.sysbuild"
osource "/zephyr/soc/intel/alder_lake/Kconfig.sysbuild"
osource "/zephyr/soc/infineon/cat3/Kconfig.sysbuild"
osource "/zephyr/soc/infineon/cat1b/Kconfig.sysbuild"
osource "/zephyr/soc/infineon/cat1a/Kconfig.sysbuild"
osource "/zephyr/soc/gd/gd32/Kconfig.sysbuild"
osource "/zephyr/soc/gaisler/leon3/Kconfig.sysbuild"
osource "/zephyr/soc/gaisler/gr716a/Kconfig.sysbuild"
osource "/zephyr/soc/espressif/Kconfig.sysbuild"
osource "/zephyr/soc/ene/kb1200/Kconfig.sysbuild"
osource "/zephyr/soc/efinix/sapphire/Kconfig.sysbuild"
osource "/zephyr/soc/cdns/xtensa_sample_controller/Kconfig.sysbuild"
osource "/zephyr/soc/cdns/dc233c/Kconfig.sysbuild"
osource "/zephyr/soc/brcm/bcmvk/Kconfig.sysbuild"
osource "/zephyr/soc/brcm/bcm2712/Kconfig.sysbuild"
osource "/zephyr/soc/brcm/bcm2711/Kconfig.sysbuild"
osource "/zephyr/soc/atmel/sam0/Kconfig.sysbuild"
osource "/zephyr/soc/atmel/sam/Kconfig.sysbuild"
osource "/zephyr/soc/aspeed/Kconfig.sysbuild"
osource "/zephyr/soc/arm/Kconfig.sysbuild"
osource "/zephyr/soc/arm/beetle/Kconfig.sysbuild"
osource "/zephyr/soc/andestech/Kconfig.sysbuild"
osource "/zephyr/soc/ambiq/Kconfig.sysbuild"
osource "/zephyr/soc/altr/zephyr_nios2f/Kconfig.sysbuild"
osource "/zephyr/soc/altr/qemu_nios2/Kconfig.sysbuild"
osource "/zephyr/soc/adi/max32/Kconfig.sysbuild"
```
