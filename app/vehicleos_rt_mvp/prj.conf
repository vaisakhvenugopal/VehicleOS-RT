## CMakeLists.txt
```
cmake_minimum_required(VERSION 3.20.0)
find_package(Zephyr REQUIRED HINTS $ENV{ZEPHYR_BASE})
project(vehicleos_rt_mvp)

target_sources(app PRIVATE
  src/main.c
  ../../platform/store/store.c
  ../../platform/bus/bus.c
  ../../platform/policy/policy.c
  ../../platform/gateway/gateway.c
  ../../platform/sdk/vo_sdk.c
  ../../generated/signals/vss_registry.c
  ../../domains/cabin/lambdas/cabin_sensor_sim.c
  ../../domains/cabin/lambdas/cabin_hvac_controller.c
  ../../domains/cabin/lambdas/cabin_precondition_procedure.c
  ../../domains/cabin/lambdas/cabin_lambdas_init.c
  ../../domains/body/lambdas/body_door_controller.c
  ../../domains/body/lambdas/body_sensor_sim.c
  ../../domains/body/lambdas/body_lambdas_init.c
  ../../domains/powertrain/lambdas/powertrain_speed_sim.c
  ../../domains/powertrain/lambdas/chassis_longitudinal_controller_sim.c
  ../../domains/powertrain/lambdas/chassis_lateral_controller_sim.c
  ../../domains/powertrain/lambdas/powertrain_lambdas_init.c
  ../../tools/cli_client.c
  ../../platform/tools/cli_server/cli_server.c
)

target_include_directories(app PRIVATE
  ${CMAKE_CURRENT_LIST_DIR}/../../
  ${CMAKE_CURRENT_LIST_DIR}/../../generated/signals
)
```

## prj.conf
```kconfig
CONFIG_LOG=y
CONFIG_LOG_MODE_IMMEDIATE=y
CONFIG_LOG_DEFAULT_LEVEL=3
CONFIG_PRINTK=y
CONFIG_CONSOLE=y
CONFIG_UART_CONSOLE=y
CONFIG_SERIAL=y
CONFIG_ZBUS=y
CONFIG_EVENTS=y
CONFIG_HEAP_MEM_POOL_SIZE=4096
CONFIG_MAIN_STACK_SIZE=4096
CONFIG_NETWORKING=y
CONFIG_NET_IPV4=y
CONFIG_NET_TCP=y
CONFIG_NET_SOCKETS=y
CONFIG_NET_CONFIG_AUTO_INIT=y
CONFIG_NET_CONFIG_SETTINGS=y
CONFIG_NET_DHCPV4=y
CONFIG_ENTROPY_GENERATOR=y
CONFIG_TEST_RANDOM_GENERATOR=y
```

## src/main.c
```c
#include <zephyr/kernel.h>
#include <zephyr/logging/log.h>
#include "vss_handles.h"
#include "platform/store/store.h"
#include "platform/bus/bus.h"
#include "platform/gateway/gateway.h"
#include "domains/cabin/lambdas/cabin_lambdas.h"
#include "domains/body/lambdas/body_lambdas.h"
#include "domains/powertrain/lambdas/powertrain_lambdas.h"
#include "tools/cli_client.h"
#include "platform/tools/cli_server/cli_server.h"

LOG_MODULE_REGISTER(vehicleos_main, LOG_LEVEL_INF);

/* 
 * MVP Main Entry Point
 * Initializes Store, Bus, and Lambdas
 */
int main(void)
{
    LOG_INF("VehicleOS-RT MVP Booting...");
    
    // 1. Init Store
    store_init();

    // 2. Init Z-bus Backbone (stub)
    bus_init();

    // 3. Init Gateway (stub)
    gateway_init();

    // 4. Init Lambdas
    cabin_lambdas_init();
    body_lambdas_init();
    powertrain_lambdas_init();

    // 5. Init CLI client (stub)
    cli_client_init();

    // 6. Init CLI server (TCP)
    cli_server_init();

    LOG_INF("VehicleOS-RT MVP Ready. Waiting for commands...");
    
    return 0;
}
```
